## arch/arm/configs/sun8i_vt960v1_defconfig
```kconfig
CONFIG_POSIX_MQUEUE=y
CONFIG_NO_HZ=y
CONFIG_HIGH_RES_TIMERS=y
CONFIG_IKCONFIG=y
CONFIG_IKCONFIG_PROC=y
CONFIG_CGROUPS=y
CONFIG_BLK_DEV_INITRD=y
CONFIG_PERF_EVENTS=y
CONFIG_ARCH_SUNXI=y
CONFIG_SMP=y
CONFIG_NR_CPUS=8
CONFIG_HIGHMEM=y
CONFIG_ZBOOT_ROM_TEXT=0
CONFIG_ZBOOT_ROM_BSS=0
CONFIG_ARM_APPENDED_DTB=y
CONFIG_ARM_ATAG_DTB_COMPAT=y
CONFIG_CPU_FREQ=y
CONFIG_CPU_FREQ_STAT=y
CONFIG_CPU_FREQ_DEFAULT_GOV_ONDEMAND=y
CONFIG_CPUFREQ_DT=y
CONFIG_CPU_IDLE=y
CONFIG_ARM_CPUIDLE=y
CONFIG_VFP=y
CONFIG_NEON=y
# CONFIG_SECCOMP is not set
CONFIG_MODULES=y
CONFIG_MODULE_FORCE_LOAD=y
CONFIG_MODULE_UNLOAD=y
CONFIG_MODULE_FORCE_UNLOAD=y
CONFIG_NET=y
CONFIG_PACKET=y
CONFIG_UNIX=y
CONFIG_INET=y
CONFIG_IP_PNP=y
CONFIG_IP_PNP_DHCP=y
CONFIG_IP_PNP_BOOTP=y
# CONFIG_INET_DIAG is not set
# CONFIG_IPV6 is not set
CONFIG_CAN=y
CONFIG_CAN_SUN4I=m
CONFIG_CAN_EMS_USB=m
CONFIG_CAN_DEBUG_DEVICES=y
# CONFIG_WIRELESS is not set
CONFIG_DEVTMPFS=y
CONFIG_DEVTMPFS_MOUNT=y
CONFIG_GNSS=m
CONFIG_MTD=y
CONFIG_MTD_BLOCK=y
CONFIG_MTD_BLOCK2MTD=y
CONFIG_MTD_SPI_NOR=y
CONFIG_BLK_DEV_SD=y
CONFIG_ATA=y
CONFIG_AHCI_SUNXI=y
CONFIG_NETDEVICES=y
CONFIG_SUN4I_EMAC=y
# CONFIG_NET_VENDOR_ARC is not set
# CONFIG_NET_VENDOR_BROADCOM is not set
# CONFIG_NET_VENDOR_CIRRUS is not set
# CONFIG_NET_VENDOR_FARADAY is not set
# CONFIG_NET_VENDOR_INTEL is not set
# CONFIG_NET_VENDOR_MARVELL is not set
# CONFIG_NET_VENDOR_MICREL is not set
# CONFIG_NET_VENDOR_MICROCHIP is not set
# CONFIG_NET_VENDOR_NATSEMI is not set
# CONFIG_NET_VENDOR_SAMSUNG is not set
# CONFIG_NET_VENDOR_SEEQ is not set
# CONFIG_NET_VENDOR_SMSC is not set
CONFIG_STMMAC_ETH=y
# CONFIG_NET_VENDOR_VIA is not set
# CONFIG_NET_VENDOR_WIZNET is not set
CONFIG_MICREL_PHY=y
# CONFIG_WLAN is not set
CONFIG_INPUT_POLLDEV=y
CONFIG_INPUT_MOUSEDEV=y
CONFIG_INPUT_EVDEV=y
CONFIG_KEYBOARD_SUN4I_LRADC=m
# CONFIG_INPUT_MOUSE is not set
CONFIG_INPUT_MISC=y
CONFIG_INPUT_AXP20X_PEK=y
CONFIG_SERIAL_8250=y
# CONFIG_SERIAL_8250_16550A_VARIANTS is not set
CONFIG_SERIAL_8250_CONSOLE=y
CONFIG_SERIAL_8250_NR_UARTS=8
CONFIG_SERIAL_8250_RUNTIME_UARTS=8
CONFIG_SERIAL_8250_DW=y
CONFIG_SERIAL_OF_PLATFORM=y
CONFIG_N_GSM=y
CONFIG_HW_RANDOM=y
CONFIG_DEVKMEM=y
CONFIG_I2C_CHARDEV=y
CONFIG_I2C_MV64XXX=y
CONFIG_I2C_SUN6I_P2WI=y
CONFIG_SPI=y
CONFIG_SPI_SUN4I=y
CONFIG_SPI_SUN6I=y
CONFIG_SPI_SPIDEV=y
CONFIG_GPIO_SYSFS=y
CONFIG_POWER_RESET=y
CONFIG_POWER_SUPPLY=y
CONFIG_CHARGER_AXP20X=y
CONFIG_BATTERY_AXP20X=y
CONFIG_AXP20X_POWER=y
CONFIG_THERMAL=y
CONFIG_THERMAL_GOV_USER_SPACE=y
CONFIG_SUN8I_THERMAL=y
CONFIG_WATCHDOG=y
CONFIG_SUNXI_WATCHDOG=y
CONFIG_MFD_AC100=y
CONFIG_MFD_AXP20X_I2C=y
CONFIG_MFD_AXP20X_RSB=y
CONFIG_REGULATOR=y
CONFIG_REGULATOR_FIXED_VOLTAGE=y
CONFIG_REGULATOR_AXP20X=y
CONFIG_REGULATOR_GPIO=y
CONFIG_MEDIA_SUPPORT=y
CONFIG_MEDIA_CAMERA_SUPPORT=y
CONFIG_MEDIA_ANALOG_TV_SUPPORT=y
CONFIG_MEDIA_DIGITAL_TV_SUPPORT=y
CONFIG_VIDEO_V4L2_SUBDEV_API=y
CONFIG_VIDEO_ADV_DEBUG=y
# CONFIG_DVB_DYNAMIC_MINORS is not set
CONFIG_MEDIA_USB_SUPPORT=y
CONFIG_USB_VIDEO_CLASS=y
CONFIG_USB_PWC=m
CONFIG_VIDEO_USBTV=m
CONFIG_DRM=y
CONFIG_DRM_VGEM=m
CONFIG_DRM_SUN4I=y
# CONFIG_DRM_SUN4I_HDMI is not set
# CONFIG_DRM_SUN4I_BACKEND is not set
# CONFIG_DRM_SUN6I_DSI is not set
CONFIG_DRM_SUN8I_DW_HDMI=y
CONFIG_FB_SIMPLE=y
CONFIG_SOUND=y
CONFIG_SND=y
CONFIG_SND_DUMMY=y
CONFIG_SND_SOC=y
CONFIG_SND_SUN4I_CODEC=m
CONFIG_SND_SUN8I_CODEC=m
CONFIG_SND_SUN8I_CODEC_ANALOG=m
CONFIG_USB=y
CONFIG_USB_ANNOUNCE_NEW_DEVICES=y
CONFIG_USB_OTG=y
CONFIG_USB_EHCI_HCD=y
CONFIG_USB_EHCI_HCD_PLATFORM=y
CONFIG_USB_OHCI_HCD=y
CONFIG_USB_OHCI_HCD_PLATFORM=y
CONFIG_USB_ACM=y
CONFIG_USB_STORAGE=y
CONFIG_USB_MUSB_HDRC=y
CONFIG_USB_MUSB_SUNXI=y
CONFIG_USB_SERIAL=y
CONFIG_USB_SERIAL_CH341=y
CONFIG_USB_SERIAL_CP210X=y
CONFIG_USB_SERIAL_FTDI_SIO=y
CONFIG_USB_SERIAL_PL2303=y
CONFIG_NOP_USB_XCEIV=y
CONFIG_USB_GADGET=y
CONFIG_USB_GADGET_DEBUG_FILES=y
CONFIG_USB_GADGET_DEBUG_FS=y
CONFIG_U_SERIAL_CONSOLE=y
CONFIG_USB_ZERO=m
CONFIG_USB_MASS_STORAGE=m
CONFIG_USB_G_SERIAL=m
CONFIG_USB_G_ACM_MS=m
CONFIG_MMC=y
CONFIG_MMC_SUNXI=y
CONFIG_NEW_LEDS=y
CONFIG_LEDS_CLASS=y
CONFIG_LEDS_GPIO=y
CONFIG_LEDS_TRIGGERS=y
CONFIG_LEDS_TRIGGER_HEARTBEAT=y
CONFIG_LEDS_TRIGGER_DEFAULT_ON=y
CONFIG_RTC_CLASS=y
CONFIG_RTC_HCTOSYS_DEVICE="rtc1"
# CONFIG_RTC_INTF_PROC is not set
CONFIG_RTC_DRV_DS1307=y
CONFIG_RTC_DRV_SUNXI=y
CONFIG_DMADEVICES=y
CONFIG_DMA_SUN6I=y
CONFIG_DMATEST=m
CONFIG_UDMABUF=y
CONFIG_DMABUF_HEAPS=y
CONFIG_DMABUF_HEAPS_CMA=y
CONFIG_UIO=y
CONFIG_STAGING=y
CONFIG_STAGING_MEDIA=y
CONFIG_VIDEO_SUNXI=y
CONFIG_VIDEO_SUNXI_CEDAR_VE=m
CONFIG_VIDEO_SUNXI_CEDAR_ION=y
# CONFIG_SUN8I_A83T_CCU is not set
# CONFIG_SUN8I_V3S_CCU is not set
# CONFIG_SUN9I_A80_CCU is not set
# CONFIG_IOMMU_SUPPORT is not set
CONFIG_PM_DEVFREQ=y
CONFIG_DEVFREQ_GOV_SIMPLE_ONDEMAND=y
CONFIG_DEVFREQ_GOV_PERFORMANCE=y
CONFIG_DEVFREQ_GOV_USERSPACE=y
CONFIG_IIO=y
CONFIG_IIO_TRIGGER=y
CONFIG_IIO_SW_DEVICE=y
CONFIG_IIO_SW_TRIGGER=y
CONFIG_AXP20X_ADC=y
CONFIG_PWM=y
CONFIG_PWM_SUN4I=y
CONFIG_PHY_SUN4I_USB=y
CONFIG_PHY_SUN6I_MIPI_DPHY=y
CONFIG_PHY_SUN9I_USB=y
CONFIG_NVMEM_SUNXI_SID=y
CONFIG_COUNTER=y
CONFIG_EXT4_FS=y
CONFIG_FUSE_FS=y
CONFIG_VFAT_FS=y
CONFIG_TMPFS=y
CONFIG_JFFS2_FS=y
CONFIG_NFS_FS=y
CONFIG_NFS_V3_ACL=y
CONFIG_NFS_V4=y
CONFIG_ROOT_NFS=y
CONFIG_NLS_CODEPAGE_437=y
CONFIG_NLS_ISO8859_1=y
CONFIG_LSM="lockdown,yama,loadpin,safesetid,integrity"
CONFIG_CRYPTO_DEV_SUN4I_SS=y
CONFIG_CRYPTO_DEV_SUN8I_CE=y
CONFIG_CRC_CCITT=y
CONFIG_CMA_SIZE_MBYTES=80
CONFIG_PRINTK_TIME=y
CONFIG_DEBUG_FS=y
CONFIG_DEBUG_KERNEL=y
CONFIG_IRQSOFF_TRACER=y
```

## arch/arm/mach-sun5i/Kconfig
```kconfig
if ARCH_SUN5I

comment "Allwinner A12/A13 options"

config SUN5I_FPGA
	bool "FPGA board support"

endif
```

## drivers/gpu/pvr/Kconfig
```kconfig
config PVR_SGX
	tristate "PowerVR SGX support"
	depends on ARCH_SUN6I && LYCHEE_FB_SUN6I 
	default y
	help
	  Enable this option to build support for the PowerVR SGX 3D core.

	  To compile this driver as a module, choose M here:
	  this will generate two modules, called pvrsrvkm and dc_sunxi.
```

## drivers/misc/sw_2g_module/Kconfig
```kconfig
#
# softwinner 2G module driver.
#

menuconfig SW_2G_MODULE
    tristate "softwinner 2G module driver"
    help
        softwinner 2G module driver

choice

    prompt "2G modem support"
    depends on SW_2G_MODULE
    help
        2G modem slecet.

config HUAWEI_MU509
    boolean "huawei mu509"
    help
        huawei mu509 modem support.

config YUGA_CWM600
    boolean "yuga cwm600"
    help
        yuga cwm600 modem support.

config OVIPHONE_EM55
    boolean "Oviphone em55"
    help
        Oviphone em55 modem support.

endchoice
```

## drivers/misc/sw_3g_module/Kconfig
```kconfig
#
# softwinner 3G module driver.
#

menuconfig SW_3G_MODULE
    tristate "softwinner 3G module driver"
    help
        softwinner 3G module driver

choice

    prompt "3G modem support"
    depends on SW_3G_MODULE
    help
        3G modem slecet.

config HUAWEI_MU509
    boolean "huawei mu509"
    select SW_USB_3G_MODULE
    help
        huawei mu509 modem support.

config YUGA_CWM600
    boolean "yuga cwm600"
    select SW_USB_3G_MODULE
    help
        yuga cwm600 modem support.

config OVIPHONE_EM55
    boolean "Oviphone em55"
    select SW_UART_3G_MODULE
    help
        Oviphone em55 modem support.

endchoice

# Selected by 3G modem that use usb interface
config SW_USB_3G_MODULE
	bool

# Selected by 3G modem that use uart interface
config SW_UART_3G_MODULE
	bool
```

## drivers/power/axp_power/Kconfig
```kconfig
menuconfig AW_AXP
	bool "AXP Power drivers"
	depends on REGULATOR
	default n
	---help---
	  This option allows you to select AXP power driver

if AW_AXP

choice
	prompt "AXP PMU type"
	default AW1636

config AW1636
	bool "AW1636 driver"
	---help---
	  AW1636 driver

endchoice
config AXP_CHARGEINIT
	bool "AXP initial charging environment set"
	default n

config AXP_CHGCHANGE
	bool "AXP charging current set when suspend\resume\shutdown"
	default y
	
config AW1636_COU
	bool "COULOMB"
	default y
	---help---
			AXP driver for coulomb

endif # !AW_AXP
```

## drivers/staging/media/sunxi/cedar/ve/Kconfig
```kconfig
# SPDX-License-Identifier: GPL-2.0
config VIDEO_SUNXI_CEDAR_VE
	tristate "Allwinner CedarX VideoEngine Driver"
	select DMA_SHARED_BUFFER
	help
	  This is the driver for sunxi video decoder, including h264/
	  mpeg4/mpeg2/vc1/rmvb.
	  https://github.com/aodzip/cedar
	  https://github.com/Tuetuopay/cedar

	  To compile this driver as a module, choose M here: the
	  module will be called cedar_dev.
```

## drivers/staging/vt900/Kconfig
```kconfig
#
# vt900
#

config SENSORS_A20_TP_HWMON
	tristate "A20 SoC TP sensor controller"
#	depends on !TOUCHSCREEN_SUN4I_TS
	help
	  If you say yes here you get support for the hardware monitoring
	  sensor present in the touch screen controler present on A20 SoC.
	  This driver handle only this, if you want the full usage of the TP
	  you need the other driver named sun4i-ts.
	  
config VT900_GPADC
	tristate "VT900 ADC driver"
	depends on STAGING && !TOUCHSCREEN_SUN4I_TS && !SENSORS_A20_TP_HWMON
	default m
	help
		VT900 internal ADC
```

## drivers/staging/vt9xx/Kconfig
```kconfig
#
# Vutlan vt9xx
#

config VT9XX_GPADC
	tristate "VT9xx ADC driver"
	depends on STAGING && !TOUCHSCREEN_SUN4I_TS && !SENSORS_A20_TP_HWMON && !MFD_SUN4I_GPADC
	default m
	help
		VT9xx internal ADC
```

## drivers/sunxi_gpio/Kconfig
```kconfig
#
# GPIO_AW configuration
#

menuconfig NEW_GPIO
	bool "GPIO_AW support"
	help
		this a module which control single of our board`s gpio

if NEW_GPIO

config GPIO_AW_CLASS
	bool "gpio class  Support"

comment "GPIO_AW drivers"
config GPIO_AW
	tristate "gpio support for the aw"
	depends on NEW_GPIO
	depends on GPIO_AW_CLASS
	default m	
endif # GPIO_AW
```

## drivers/test/nand/Kconfig
```kconfig
config SUN4I_NANDFLASH_TEST
        tristate "SUN6I Nandflash_test Driver"
        ---help---
          Nand flash driver for SUN4I
```
